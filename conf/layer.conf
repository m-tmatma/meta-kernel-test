## conf/layer.conf
```bitbake
# We have a conf and classes directory, add to BBPATH
BBPATH .= ":${LAYERDIR}"

# We have recipes-* directories, add to BBFILES
BBFILES += "${LAYERDIR}/recipes-*/*/*.bb \
            ${LAYERDIR}/recipes-*/*/*.bbappend"

BBFILE_COLLECTIONS += "meta-kernel-test"
BBFILE_PATTERN_meta-kernel-test = "^${LAYERDIR}/"
BBFILE_PRIORITY_meta-kernel-test = "6"

LAYERDEPENDS_meta-kernel-test = "core"
LAYERSERIES_COMPAT_meta-kernel-test = "warrior zeus"
```
